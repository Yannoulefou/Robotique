// generated by mBlock5 for mBot
// codes make you happy

#include <MeMCore.h>
#include <Arduino.h>
#include <Wire.h>
#include <SoftwareSerial.h>

MeUltrasonicSensor ultrasonic_3(3);
MeDCMotor motor_9(9);
MeDCMotor motor_10(10);

float nb_if = 0;


void move(int direction, int speed) {
  int leftSpeed = 0;
  int rightSpeed = 0;
  if(direction == 1) {
    leftSpeed = speed;
    rightSpeed = speed;
  } else if(direction == 2) {
    leftSpeed = -speed;
    rightSpeed = -speed;
  } else if(direction == 3) {
    leftSpeed = -speed;
    rightSpeed = speed;
  } else if(direction == 4) {
    leftSpeed = speed;
    rightSpeed = -speed;
  }
  motor_9.run((9) == M1 ? -(leftSpeed) : (leftSpeed));
  motor_10.run((10) == M1 ? -(rightSpeed) : (rightSpeed));
}

void _delay(float seconds) {
  long endTime = millis() + seconds * 1000;
  while(millis() < endTime) _loop();
}



void setup() {
  Serial.begin(115200);
  while (!Serial) {
    delay(10);
  }

  Serial.println(ultrasonic_3.distanceCm());
  delay(100);

  while(ultrasonic_3.distanceCm() < 5)
  {
    Serial.print("distance : ");
    Serial.println(ultrasonic_3.distanceCm());
    delay(500);

  }
  delay(91000);
  while(!(nb_if == 10))
  {
    _loop();
    if(ultrasonic_3.distanceCm() > 13){

      move(1, 50 / 100.0 * 255);
      _delay(0.5);
      move(1, 0);
      nb_if += 1;


    }

  }

  // move(1, 50 / 100.0 * 255);
  // _delay(4);
  // move(1, 0);

}

void _loop() {
}

void loop() {
  _loop();
}




  // Serial.print("distance_hors_while : ");
  // Serial.println(ultrasonic_3.distanceCm());
  // delay(500);


